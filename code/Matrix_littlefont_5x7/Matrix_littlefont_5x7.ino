#include <Arduino.h>
#include <ShiftRegister74HC595.h>  // https://blog.timodenk.com/shift-register-arduino-library/

// === CONFIGURACIÓN DE PINES ===
#define DATA_PIN 23   // DS
#define CLOCK_PIN 18  // SHCP
#define LATCH_PIN 19  // STCP

#define MATRIX_ROWS 18
#define MATRIX_COLS 96

// Instancia de 3 registros 74HC595 (para 24 columnas)
ShiftRegister74HC595<12> sr(DATA_PIN, CLOCK_PIN, LATCH_PIN);

// Pines de filas (controladas por TIP122)
const uint8_t filas[MATRIX_ROWS] = {
  3, 1, 2, 4, 5,
  12, 13, 14, 15, 16,
  17, 21, 22, 25, 26,
  27, 32, 33
};

// ==============================
// Fuente 5x7 (ASCII 32 a 127)
// Cada carácter es 5 columnas (bits verticales), bit 0 abajo
// ==============================
const uint8_t font5x7[][5] = {
  { 0x00, 0x00, 0x00, 0x00, 0x00 },  // 32 ' '
  { 0x00, 0x00, 0x5F, 0x00, 0x00 },  // 33 '!'
  { 0x00, 0x07, 0x00, 0x07, 0x00 },  // 34 '"'
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  { 0x00, 0x00, 0x00, 0x00, 0x00 }   // 127 (DEL) - vacío
};


// Buffer de pantalla
uint8_t buffer[MATRIX_ROWS][MATRIX_COLS] = { 0 };

// ==============================
// Funciones de control de filas
// ==============================
void prenderFila(uint8_t fila) {
  digitalWrite(filas[fila], HIGH);
}

void apagarFila(uint8_t fila) {
  digitalWrite(filas[fila], LOW);
}

// ==============================
// Dibuja un carácter en el buffer
// ==============================
void dibujarChar(char c, int x, int y) {
  if (c < 32 || c > 126) c = 32;  // espacio si no existe
  const uint8_t *bitmap = font5x7[c - 32];
  for (int col = 0; col < 5; col++) {
    uint8_t colBits = bitmap[col];
    for (int row = 0; row < 7; row++) {
      bool pixel = colBits & (1 << row);
      int dx = x + col;
      int dy = y + row;
      if (dx >= 0 && dx < MATRIX_COLS && dy >= 0 && dy < MATRIX_ROWS) {
        buffer[dy][dx] = pixel;
      }
    }
  }
}

// ==============================
// Desplaza el buffer a la izquierda
// ==============================
void scrollIzquierda() {
  for (int row = 0; row < MATRIX_ROWS; row++) {
    for (int col = 0; col < MATRIX_COLS - 1; col++) {
      buffer[row][col] = buffer[row][col + 1];
    }
    buffer[row][MATRIX_COLS - 1] = 0;
  }
}

// ==============================
// Refresca la matriz (multiplexado)
// ==============================
void refrescarMatriz() {
  for (int fila = 0; fila < MATRIX_ROWS; fila++) {
    apagarFila(fila); // Apagamos fila antes de cambiar columnas
  }

  for (int fila = 0; fila < MATRIX_ROWS; fila++) {
    // Preparamos los datos de las columnas
    sr.setAllLow();
    for (int col = 0; col < MATRIX_COLS; col++) {
      sr.set(col, buffer[fila][col] ? HIGH : LOW);
    }
    prenderFila(fila);
    delayMicroseconds(50); // Mucho más rápido para que sea invisible
    apagarFila(fila);
  }
}


// ==============================
// Configuración
// ==============================
const char mensaje[] = "BIENVENIDOS EXPO HUERGO 2025 ";

void setup() {
  for (int i = 0; i < MATRIX_ROWS; i++) {
    pinMode(filas[i], OUTPUT);
    apagarFila(i);
  }
  sr.setAllLow();

  // Dibuja la primera letra justo al inicio, centrada verticalmente
  dibujarChar(mensaje[0], MATRIX_COLS - 5, 5);
}

// ==============================
// Programa principal
// ==============================
int charIndex = 0;
int colCount = 0;

void loop() {

  // Refresco continuo
  refrescarMatriz();

  static unsigned long lastScroll = 0;
  if (millis() - lastScroll > 100) {  // velocidad scroll
    lastScroll = millis();
    scrollIzquierda();
    colCount++;
    if (colCount >= 6) {  // 5 columnas + 1 espacio
      colCount = 0;
      charIndex++;
      if (charIndex >= strlen(mensaje)) charIndex = 0;
      dibujarChar(mensaje[charIndex], MATRIX_COLS - 5, 5);  // y=5 para centrar vertical
    }
  }
}
